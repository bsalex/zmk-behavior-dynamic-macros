## Kconfig
```kconfig
menu "Dynamic Macros Options"

config ZMK_BEHAVIOR_DYNAMIC_MACROS
	bool "enabled"
	default n

config ZMK_BEHAVIOR_DYNAMIC_MACROS_NUMBER
    int "Number of dynamic macros"
    default 5
    depends on ZMK_BEHAVIOR_DYNAMIC_MACROS

config ZMK_BEHAVIOR_DYNAMIC_MACROS_MAX_LENGTH
    int "Max length of a macro sequence"
    default 1000
    depends on ZMK_BEHAVIOR_DYNAMIC_MACROS

config ZMK_BEHAVIOR_DYNAMIC_MACROS_MAX_RECORDING_TIME
    int "Max recording time (ms)"
    default 60000
    depends on ZMK_BEHAVIOR_DYNAMIC_MACROS

endmenu

module = ZMK_BEHAVIOR_DYNAMIC_MACROS
module-str = zmk_behavior_dynamic_macros
source "subsys/logging/Kconfig.template.log_config"
```

## dts/bindings/behaviors/zmk,behavior-dm-play-loop.yaml
```yaml
description: Dynamic Macros Loop Playback Behavior

compatible: "zmk,behavior-dm-play-loop"

include: one_param.yaml
```

## dts/bindings/behaviors/zmk,behavior-dm-play-stop.yaml
```yaml
description: Dynamic Macros Play Stop Behavior

compatible: "zmk,behavior-dm-play-stop"

include: zero_param.yaml
```

## dts/bindings/behaviors/zmk,behavior-dm-play.yaml
```yaml
description: Dynamic Macros Play Behavior

compatible: "zmk,behavior-dm-play"

include: one_param.yaml
```

## dts/bindings/behaviors/zmk,behavior-dm-record-stop.yaml
```yaml
description: Dynamic Macros Record Stop Behavior

compatible: "zmk,behavior-dm-record-stop"

include: zero_param.yaml
```

## dts/bindings/behaviors/zmk,behavior-dm-record.yaml
```yaml
description: Dynamic Macros Record Behavior

compatible: "zmk,behavior-dm-record"

include: one_param.yaml
```

## dts/bindings/behaviors/zmk,behavior-dm-reset.yaml
```yaml
description: Dynamic Macros Reset behavior

compatible: "zmk,behavior-dm-reset"

include: zero_param.yaml
```

## west.yml
```yaml
manifest:
  remotes:
    - name: bsalex
      url-base: https://github.com/bsalex
  projects:
    # Together with the above defined remote, this refers to a module located at
    # https://github.com/remote-name/repository-name
    - name: zmk-behavior-dynamic-macros
      remote: bsalex
      # This points to a west manifest file in the remote module for further imports
      import: west.yml
```
