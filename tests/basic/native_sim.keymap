/*
 * Basic Dynamic Macro Test
 *
 * This test verifies the fundamental functionality of recording and replaying a macro.
 *
 * Sequence:
 * 1. Start Recording Macro 0 (Position 2,0)
 * 2. Press & Release Key 0 (Position 0,0) - Should be recorded
 * 3. Press & Release Key 3 (Position 3,0) - Should be recorded
 * 4. Press & Release Key 4 (Position 3,1) - Should be recorded
 * 5. Stop Recording (Position 2,0)
 * 6. Play Macro 0 (Position 1,0) - Should replay the recorded keys
 */
#include <dt-bindings/zmk/keys.h>
#include <behaviors.dtsi>
#include <dt-bindings/zmk/kscan_mock.h>
#include "../behavior_keymap.dtsi"

&kscan {
    events = <
        ZMK_MOCK_PRESS(0,0,10)
        ZMK_MOCK_RELEASE(0,0,10)
        ZMK_MOCK_PRESS(5,0,10)
        ZMK_MOCK_RELEASE(5,0,10)
        ZMK_MOCK_PRESS(5,1,10)
        ZMK_MOCK_RELEASE(5,1,10)
        ZMK_MOCK_PRESS(2,0,10)
        ZMK_MOCK_RELEASE(2,0,10)
        ZMK_MOCK_PRESS(1,0,10)
        ZMK_MOCK_RELEASE(1,0,100)
    >;
};
