/*
 * Stop Record Test
 *
 * This test verifies that the Stop Record behavior correctly terminates recording
 * and ignores subsequent key presses.
 *
 * Sequence:
 * 1. Start Recording Macro 0 (Position 2,0)
 * 2. Press Key 0 (0,0) - Should be recorded
 * 3. Press Key 1 (3,0) - Should be recorded
 * 4. Press Stop Record (Position 2,0)
 * 5. Press Key 2 (3,1) - Should NOT be recorded
 * 6. Play Macro 0
 *
 * Expected Result: Macro 0 should replay correctly, but exclude Key 2.
 */
#include <dt-bindings/zmk/keys.h>
#include <behaviors.dtsi>
#include <dt-bindings/zmk/kscan_mock.h>
#include "../behavior_keymap.dtsi"

&kscan {
    events = <
        ZMK_MOCK_PRESS(0,0,10)
        ZMK_MOCK_RELEASE(0,0,10)
        ZMK_MOCK_PRESS(5,0,10)
        ZMK_MOCK_RELEASE(5,0,10)
        // Check trim
        ZMK_MOCK_PRESS(2,0,10) // Stop record
        ZMK_MOCK_RELEASE(2,0,10)
        ZMK_MOCK_PRESS(5,1,10) // Should be ignored
        ZMK_MOCK_RELEASE(5,1,10)
        ZMK_MOCK_PRESS(1,0,10)
        ZMK_MOCK_RELEASE(1,0,100)
    >;
};
